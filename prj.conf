## CMakeLists.txt
```
# SPDX-License-Identifier: Apache-2.0

cmake_minimum_required(VERSION 3.20.0)

set(TARGET "$ENV{TARGET}")
message("Target is " ${TARGET})

if(${TARGET} STREQUAL "riscv")

# RiscV target, Zephyr

set(DTC_OVERLAY_FILE "doom.overlay")
find_package(Zephyr REQUIRED HINTS $ENV{ZEPHYR_BASE})
#zephyr_compile_definitions(ZEPHYR=1 NORMALUNIX=1)
set(PLF_INC $ENV{ZEPHYR_BASE}/include)
add_compile_options(-v -g -Wall -DNORMALUNIX)

set(PLF_FILES
    ${CMAKE_CURRENT_SOURCE_DIR}/src/riscv/d_main.c
    ${CMAKE_CURRENT_SOURCE_DIR}/src/riscv/i_main.c 
    ${CMAKE_CURRENT_SOURCE_DIR}/src/riscv/i_net.c 
    ${CMAKE_CURRENT_SOURCE_DIR}/src/riscv/i_sound.c 
    ${CMAKE_CURRENT_SOURCE_DIR}/src/riscv/i_system.c 
    ${CMAKE_CURRENT_SOURCE_DIR}/src/riscv/i_video.c 
    ${CMAKE_CURRENT_SOURCE_DIR}/src/riscv/s_sound.c 
    ${CMAKE_CURRENT_SOURCE_DIR}/src/riscv/d_zephyr.c  
    ${CMAKE_CURRENT_SOURCE_DIR}/src/riscv/mini-printf.c)


else()

# Unix based - e.g. luckfox target
set(SDK_PATH $ENV{LUCKFOX_SDK_PATH})

# check SDK
if(NOT SDK_PATH)
    message(WARNING "Please Set Luckfox-pico SDK Path. Such as:export LUCKFOX_SDK_PATH=/home/user/luckfox-pico")
    return()
else()
set(CMAKE_C_COMPILER "${SDK_PATH}/tools/linux/toolchain/arm-rockchip830-linux-uclibcgnueabihf/bin/arm-rockchip830-linux-uclibcgnueabihf-gcc")
set(CMAKE_CXX_COMPILER "${SDK_PATH}/tools/linux/toolchain/arm-rockchip830-linux-uclibcgnueabihf/bin/arm-rockchip830-linux-uclibcgnueabihf-g++")
endif()

# Opencv 4
#set(OpenCV_DIR "/work/src/luckfox/demos/luckfox_pico_rknn_example/lib/cmake/opencv4")
#find_package(OpenCV REQUIRED)
# Thread
#set(THREADS_PREFER_PTHREAD_FLAG ON)
#find_package(Threads REQUIRED)

add_compile_options(-g -Wall -DNORMALUNIX
                    -DISP_HW_V30 -DRKPLATFORM=ON -DARCH64=OFF
                    -DROCKIVA -DUAPI2
                    -D_LARGEFILE_SOURCE -D_LARGEFILE64_SOURCE
		    -D_FILE_OFFSET_BITS=64
		    -DPTHREADS -DLUCKFOX)


set(PLF_FILES ${CMAKE_CURRENT_SOURCE_DIR}/src/luckfox/d_main.c
	      ${CMAKE_CURRENT_SOURCE_DIR}/src/luckfox/i_net.c
	      ${CMAKE_CURRENT_SOURCE_DIR}/src/luckfox/i_system.c
	      ${CMAKE_CURRENT_SOURCE_DIR}/src/luckfox/i_video.c
	      ${CMAKE_CURRENT_SOURCE_DIR}/src/luckfox/i_sound.c
	      ${CMAKE_CURRENT_SOURCE_DIR}/src/luckfox/s_sound.c)

# ${CMAKE_CURRENT_SOURCE_DIR}/src/luckfox/cv-video.cpp

endif()

# src/riscv/libc_backend.c  
# src/riscv/console.c  
# src/riscv/c64-lib.cpp

message(STATUS "Plf includes: " ${PLF_INC})
include_directories(src ${PLF_INC})
add_link_options()

set(SRC 
	${CMAKE_CURRENT_SOURCE_DIR}/src/am_map.c 
	${CMAKE_CURRENT_SOURCE_DIR}/src/d_items.c 
	${CMAKE_CURRENT_SOURCE_DIR}/src/d_net.c 
	${CMAKE_CURRENT_SOURCE_DIR}/src/doomdef.c 
	${CMAKE_CURRENT_SOURCE_DIR}/src/doomstat.c 
	${CMAKE_CURRENT_SOURCE_DIR}/src/dstrings.c
  ${CMAKE_CURRENT_SOURCE_DIR}/src/f_finale.c 
  ${CMAKE_CURRENT_SOURCE_DIR}/src/f_wipe.c 
  ${CMAKE_CURRENT_SOURCE_DIR}/src/g_game.c 
  ${CMAKE_CURRENT_SOURCE_DIR}/src/hu_lib.c 
  ${CMAKE_CURRENT_SOURCE_DIR}/src/hu_stuff.c 
  ${CMAKE_CURRENT_SOURCE_DIR}/src/info.c 
  ${CMAKE_CURRENT_SOURCE_DIR}/src/m_argv.c 
  ${CMAKE_CURRENT_SOURCE_DIR}/src/m_bbox.c 
  ${CMAKE_CURRENT_SOURCE_DIR}/src/m_cheat.c 
  ${CMAKE_CURRENT_SOURCE_DIR}/src/m_fixed.c 
  ${CMAKE_CURRENT_SOURCE_DIR}/src/m_menu.c 
  ${CMAKE_CURRENT_SOURCE_DIR}/src/m_misc.c 
  ${CMAKE_CURRENT_SOURCE_DIR}/src/m_random.c 
  ${CMAKE_CURRENT_SOURCE_DIR}/src/m_swap.c 
  ${CMAKE_CURRENT_SOURCE_DIR}/src/p_ceilng.c 
  ${CMAKE_CURRENT_SOURCE_DIR}/src/p_doors.c 
  ${CMAKE_CURRENT_SOURCE_DIR}/src/p_enemy.c 
  ${CMAKE_CURRENT_SOURCE_DIR}/src/p_floor.c 
  ${CMAKE_CURRENT_SOURCE_DIR}/src/p_inter.c 
  ${CMAKE_CURRENT_SOURCE_DIR}/src/p_lights.c 
  ${CMAKE_CURRENT_SOURCE_DIR}/src/p_map.c 
  ${CMAKE_CURRENT_SOURCE_DIR}/src/p_maputl.c 
  ${CMAKE_CURRENT_SOURCE_DIR}/src/p_mobj.c 
  ${CMAKE_CURRENT_SOURCE_DIR}/src/p_plats.c 
  ${CMAKE_CURRENT_SOURCE_DIR}/src/p_pspr.c 
  ${CMAKE_CURRENT_SOURCE_DIR}/src/p_saveg.c 
  ${CMAKE_CURRENT_SOURCE_DIR}/src/p_setup.c 
  ${CMAKE_CURRENT_SOURCE_DIR}/src/p_sight.c 
  ${CMAKE_CURRENT_SOURCE_DIR}/src/p_spec.c 
  ${CMAKE_CURRENT_SOURCE_DIR}/src/p_switch.c 
  ${CMAKE_CURRENT_SOURCE_DIR}/src/p_telept.c 
  ${CMAKE_CURRENT_SOURCE_DIR}/src/p_tick.c 
  ${CMAKE_CURRENT_SOURCE_DIR}/src/p_user.c 
  ${CMAKE_CURRENT_SOURCE_DIR}/src/r_bsp.c 
  ${CMAKE_CURRENT_SOURCE_DIR}/src/r_data.c 
  ${CMAKE_CURRENT_SOURCE_DIR}/src/r_draw.c 
  ${CMAKE_CURRENT_SOURCE_DIR}/src/r_main.c 
  ${CMAKE_CURRENT_SOURCE_DIR}/src/r_plane.c 
  ${CMAKE_CURRENT_SOURCE_DIR}/src/r_segs.c 
  ${CMAKE_CURRENT_SOURCE_DIR}/src/r_sky.c 
  ${CMAKE_CURRENT_SOURCE_DIR}/src/r_things.c 
  ${CMAKE_CURRENT_SOURCE_DIR}/src/sounds.c 
  ${CMAKE_CURRENT_SOURCE_DIR}/src/st_lib.c 
  ${CMAKE_CURRENT_SOURCE_DIR}/src/st_stuff.c 
  ${CMAKE_CURRENT_SOURCE_DIR}/src/tables.c 
  ${CMAKE_CURRENT_SOURCE_DIR}/src/v_video.c 
  ${CMAKE_CURRENT_SOURCE_DIR}/src/wi_stuff.c 
  ${CMAKE_CURRENT_SOURCE_DIR}/src/w_wad.c 
  ${CMAKE_CURRENT_SOURCE_DIR}/src/z_zone.c 
  )

project(${TARGET}-doom)
add_executable (${PROJECT_NAME} ${SRC} ${PLF_FILES}) 

target_sources(${PROJECT_NAME} PRIVATE ${SRC} ${PLF_FILES})
#target_sources(app PRIVATE ${SRC} ${PLF_FILES})
```

## prj.conf
```kconfig
CONFIG_DISK_DRIVER_SDMMC=n
CONFIG_LOG=y
CONFIG_LOG_DEFAULT_LEVEL=4
CONFIG_FILE_SYSTEM=y
CONFIG_FAT_FILESYSTEM_ELM=n
CONFIG_PRINTK=y
CONFIG_HEAP_MEM_POOL_SIZE=0
```

## doom.overlay
```dts
/ { 
    reserved-memory {
    #address-cells = <1>;
    #size-cells    = <1>;
    ranges;

    doom1@40500000 {
        reg = <0x40500000 0x500000>;
    };

    };
};
```

## src/doomtype.h
```c
// Emacs style mode select   -*- C++ -*-
//-----------------------------------------------------------------------------
//
// $Id:$
//
// Copyright (C) 1993-1996 by id Software, Inc.
//
// This program is free software; you can redistribute it and/or
// modify it under the terms of the GNU General Public License
// as published by the Free Software Foundation; either version 2
// of the License, or (at your option) any later version.
//
// This program is distributed in the hope that it will be useful,
// but WITHOUT ANY WARRANTY; without even the implied warranty of
// MERCHANTABILITY or FITNESS FOR A PARTICULAR PURPOSE.  See the
// GNU General Public License for more details.
//
// DESCRIPTION:
//      Simple basic typedefs, isolated here to make it easier
//       separating modules.
//
//-----------------------------------------------------------------------------


#ifndef __DOOMTYPE__
#define __DOOMTYPE__


#ifndef __BYTEBOOL__
#define __BYTEBOOL__
// Fixed to use builtin bool type with C++.
#ifdef __cplusplus
typedef bool boolean;
#else
typedef enum {_false, _true} boolean;
#define false _false
#define true _true
#endif
typedef unsigned char byte;
#endif

// Limits alias
#include <limits.h>

#define MAXCHAR         ((char)CHAR_MAX)
#define MINCHAR         ((char)CHAR_MIN)

#define MAXSHORT        ((short)SHRT_MAX)
#define MINSHORT        ((short)SHRT_MIN)

#define MAXINT          ((int)INT_MAX)
#define MININT          ((int)INT_MIN)

#define MAXLONG         ((long)LONG_MAX)
#define MINLONG         ((long)LONG_MIN)


#endif
//-----------------------------------------------------------------------------
//
// $Log:$
//
//-----------------------------------------------------------------------------
```

## src/m_misc.c
```c
// Emacs style mode select   -*- C++ -*-
//-----------------------------------------------------------------------------
//
// $Id:$
//
// Copyright (C) 1993-1996 by id Software, Inc.
//
// This program is free software; you can redistribute it and/or
// modify it under the terms of the GNU General Public License
// as published by the Free Software Foundation; either version 2
// of the License, or (at your option) any later version.
//
// This program is distributed in the hope that it will be useful,
// but WITHOUT ANY WARRANTY; without even the implied warranty of
// MERCHANTABILITY or FITNESS FOR A PARTICULAR PURPOSE.  See the
// GNU General Public License for more details.
//
//
// $Log:$
//
// DESCRIPTION:
//      Main loop menu stuff.
//      Default Config File.
//      PCX Screenshots.
//
//-----------------------------------------------------------------------------

static const char __attribute__((unused))
rcsid[] = "$Id: m_misc.c,v 1.6 1997/02/03 22:45:10 b1 Exp $";


#include <errno.h>
#include <sys/stat.h>
#include <sys/types.h>
#include <fcntl.h>
#include <stdlib.h>
#include <unistd.h>

#include <ctype.h>


#include "doomdef.h"

#include "z_zone.h"

#include "m_swap.h"
#include "m_argv.h"

#include "w_wad.h"

#include "i_system.h"
#include "i_video.h"
#include "v_video.h"

#include "hu_stuff.h"

// State.
#include "doomstat.h"

// Data.
#include "dstrings.h"

#include "m_misc.h"

//
// M_DrawText
// Returns the final X coordinate
// HU_Init must have been called to init the font
//
extern patch_t*         hu_font[HU_FONTSIZE];

int
M_DrawText
( int           x,
  int           y,
  boolean       direct,
  char*         string )
{
    int         c;
    int         w;

    while (*string)
    {
        c = toupper(*string) - HU_FONTSTART;
        string++;
        if (c < 0 || c> HU_FONTSIZE)
        {
            x += 4;
            continue;
        }

        w = SHORT (hu_font[c]->width);
        if (x+w > SCREENWIDTH)
            break;
        if (direct)
            V_DrawPatchDirect(x, y, 0, hu_font[c]);
        else
            V_DrawPatch(x, y, 0, hu_font[c]);
        x+=w;
    }

    return x;
}




//
// M_WriteFile
//
#ifndef O_BINARY
#define O_BINARY 0
#endif

boolean
M_WriteFile
( char const*   name,
  void*         source,
  int           length )
{
    int         handle;
    int         count;

    handle = open ( name, O_WRONLY | O_CREAT | O_TRUNC | O_BINARY, 0666);

    if (handle == -1)
        return false;

    count = write (handle, source, length);
    close (handle);

    if (count < length)
        return false;

    return true;
}


//
// M_ReadFile
//
int
M_ReadFile
( char const*   name,
  byte**        buffer )
{
    int handle, count, length;
    struct stat fileinfo;
    byte                *buf;

    handle = open (name, O_RDONLY | O_BINARY, 0666);
    if (handle == -1)
        I_Error ("Couldn't read file %s", name);
    if (fstat (handle,&fileinfo) == -1)
        I_Error ("Couldn't read file %s", name);
    length = fileinfo.st_size;
    buf = Z_Malloc (length, PU_STATIC, NULL);
    count = read (handle, buf, length);
    close (handle);

    if (count < length)
        I_Error ("Couldn't read file %s", name);

    *buffer = buf;
    return length;
}


//
// DEFAULTS
//
int             usemouse;
int             usejoystick;

extern int      key_right;
extern int      key_left;
extern int      key_up;
extern int      key_down;

extern int      key_strafeleft;
extern int      key_straferight;

extern int      key_fire;
extern int      key_use;
extern int      key_strafe;
extern int      key_speed;

extern int      mousebfire;
extern int      mousebstrafe;
extern int      mousebforward;

extern int      joybfire;
extern int      joybstrafe;
extern int      joybuse;
extern int      joybspeed;

extern int      viewwidth;
extern int      viewheight;

extern int      mouseSensitivity;
extern int      showMessages;

extern int      detailLevel;

extern int      screenblocks;

extern int      showMessages;

// machine-independent sound params
extern  int     numChannels;


// UNIX hack, to be removed.
#ifdef SNDSERV
extern char*    sndserver_filename;
extern int      mb_used;
#endif

#ifdef LINUX
char*           mousetype;
char*           mousedev;
#endif

extern char*    chat_macros[];



typedef struct
{
    char*       name;
    int*        location;
    int         defaultvalue;
    int         scantranslate;          // PC scan code hack
    int         untranslated;           // lousy hack
} default_t;

default_t       defaults[] =
{
    {"mouse_sensitivity",&mouseSensitivity, 5},
    {"sfx_volume",&snd_SfxVolume, 8},
    {"music_volume",&snd_MusicVolume, 8},
    {"show_messages",&showMessages, 1},


#ifdef NORMALUNIX
    {"key_right",&key_right, KEY_RIGHTARROW},
    {"key_left",&key_left, KEY_LEFTARROW},
    {"key_up",&key_up, KEY_UPARROW},
    {"key_down",&key_down, KEY_DOWNARROW},
    {"key_strafeleft",&key_strafeleft, ','},
    {"key_straferight",&key_straferight, '.'},

    {"key_fire",&key_fire, KEY_RCTRL},
    {"key_use",&key_use, ' '},
    {"key_strafe",&key_strafe, KEY_RALT},
    {"key_speed",&key_speed, KEY_RSHIFT},

// UNIX hack, to be removed.
#ifdef SNDSERV
    {"sndserver", (int *) &sndserver_filename, (int) "sndserver"},
    {"mb_used", &mb_used, 2},
#endif

#endif

#ifdef LINUX
    {"mousedev", (int*)&mousedev, (int)"/dev/ttyS0"},
    {"mousetype", (int*)&mousetype, (int)"microsoft"},
#endif

    {"use_mouse",&usemouse, 1},
    {"mouseb_fire",&mousebfire,0},
    {"mouseb_strafe",&mousebstrafe,1},
    {"mouseb_forward",&mousebforward,2},

    {"use_joystick",&usejoystick, 0},
    {"joyb_fire",&joybfire,0},
    {"joyb_strafe",&joybstrafe,1},
    {"joyb_use",&joybuse,3},
    {"joyb_speed",&joybspeed,2},

    {"screenblocks",&screenblocks, 9},
    {"detaillevel",&detailLevel, 0},

    {"snd_channels",&numChannels, 3},



    {"usegamma",&usegamma, 0},

    {"chatmacro0", (int *) &chat_macros[0], 42 },
    {"chatmacro1", (int *) &chat_macros[1], 43 },
    {"chatmacro2", (int *) &chat_macros[2], 44 },
    {"chatmacro3", (int *) &chat_macros[3], 45 },
    {"chatmacro4", (int *) &chat_macros[4], 46 },
    {"chatmacro5", (int *) &chat_macros[5], 47 },
    {"chatmacro6", (int *) &chat_macros[6], 48 },
    {"chatmacro7", (int *) &chat_macros[7], 49 },
    {"chatmacro8", (int *) &chat_macros[8], 50 },
    {"chatmacro9", (int *) &chat_macros[9], 51 }

};

int     numdefaults;
char*   defaultfile;


//
// M_SaveDefaults
//
void M_SaveDefaults (void)
{
    int         i;
    int         v;
    FILE*       f;

    f = fopen (defaultfile, "w");
    if (!f)
        return; // can't write the file, but don't complain

    for (i=0 ; i<numdefaults ; i++)
    {
        if (defaults[i].defaultvalue > -0xfff
            && defaults[i].defaultvalue < 0xfff)
        {
            v = *defaults[i].location;
            fprintf (f,"%s\t\t%i\n",defaults[i].name,v);
        } else {
            fprintf (f,"%s\t\t\"%s\"\n",defaults[i].name,
                     * (char **) (defaults[i].location));
        }
    }

    fclose (f);
}


//
// M_LoadDefaults
//
extern byte     scantokey[128];

void M_LoadDefaults (void)
{
    int         i;
    int         len;
    FILE*       f;
    char        def[80];
    char        strparm[100];
    char*       newstring;
    int         parm;
    boolean     isstring;

    // set everything to base values
    numdefaults = sizeof(defaults)/sizeof(defaults[0]);
    for (i=0 ; i<numdefaults ; i++)
        *defaults[i].location = defaults[i].defaultvalue;

    // check for a custom default file
    i = M_CheckParm ("-config");
    if (i && i<myargc-1)
    {
        defaultfile = myargv[i+1];
        printf ("       default file: %s\n",defaultfile);
    }
    else
        defaultfile = basedefault;

    // read the file in, overriding any set defaults
    f = fopen (defaultfile, "r");
    if (f)
    {
        while (!feof(f))
        {
            isstring = false;
            if (fscanf (f, "%79s %[^\n]\n", def, strparm) == 2)
            {
                if (strparm[0] == '"')
                {
                    // get a string default
                    isstring = true;
                    len = strlen(strparm);
                    newstring = (char *) malloc(len);
                    strparm[len-1] = 0;
                    strcpy(newstring, strparm+1);
                }
                else if (strparm[0] == '0' && strparm[1] == 'x')
                    sscanf(strparm+2, "%x", &parm);
                else
                    sscanf(strparm, "%i", &parm);
                for (i=0 ; i<numdefaults ; i++)
                    if (!strcmp(def, defaults[i].name))
                    {
                        if (!isstring)
                            *defaults[i].location = parm;
                        else
                            *defaults[i].location =
                                (int) newstring;
                        break;
                    }
            }
        }

        fclose (f);
    }
}


//
// SCREEN SHOTS
//


typedef struct
{
    char                manufacturer;
    char                version;
    char                encoding;
    char                bits_per_pixel;

    unsigned short      xmin;
    unsigned short      ymin;
    unsigned short      xmax;
    unsigned short      ymax;

    unsigned short      hres;
    unsigned short      vres;

    unsigned char       palette[48];

    char                reserved;
    char                color_planes;
    unsigned short      bytes_per_line;
    unsigned short      palette_type;

    char                filler[58];
    unsigned char       data;           // unbounded
} pcx_t;


//
// WritePCXfile
//
void
WritePCXfile
( char*         filename,
  byte*         data,
  int           width,
  int           height,
  byte*         palette )
{
    int         i;
    int         length;
    pcx_t*      pcx;
    byte*       pack;

    pcx = Z_Malloc (width*height*2+1000, PU_STATIC, NULL);

    pcx->manufacturer = 0x0a;           // PCX id
    pcx->version = 5;                   // 256 color
    pcx->encoding = 1;                  // uncompressed
    pcx->bits_per_pixel = 8;            // 256 color
    pcx->xmin = 0;
    pcx->ymin = 0;
    pcx->xmax = SHORT(width-1);
    pcx->ymax = SHORT(height-1);
    pcx->hres = SHORT(width);
    pcx->vres = SHORT(height);
    memset (pcx->palette,0,sizeof(pcx->palette));
    pcx->color_planes = 1;              // chunky image
    pcx->bytes_per_line = SHORT(width);
    pcx->palette_type = SHORT(2);       // not a grey scale
    memset (pcx->filler,0,sizeof(pcx->filler));


    // pack the image
    pack = &pcx->data;

    for (i=0 ; i<width*height ; i++)
    {
        if ( (*data & 0xc0) != 0xc0)
            *pack++ = *data++;
        else
        {
            *pack++ = 0xc1;
            *pack++ = *data++;
        }
    }

    // write the palette
    *pack++ = 0x0c;     // palette ID byte
    for (i=0 ; i<768 ; i++)
        *pack++ = *palette++;

    // write output file
    length = pack - (byte *)pcx;
    M_WriteFile (filename, pcx, length);

    Z_Free (pcx);
}


//
// M_ScreenShot
//
void M_ScreenShot (void)
{
    int         i;
    byte*       linear;
    char        lbmname[12];
    struct stat fs;

    // munge planar buffer to linear
    linear = screens[2];
    I_ReadScreen (linear);

    // find a file name to save it to
    strcpy(lbmname,"DOOM00.pcx");

    for (i=0 ; i<=99 ; i++)
    {
        lbmname[4] = i/10 + '0';
        lbmname[5] = i%10 + '0';
        if ((stat(lbmname, &fs) == -1) && (errno == ENOENT))
            break;      // file doesn't exist
    }
    if (i==100)
        I_Error ("M_ScreenShot: Couldn't create a PCX");

    // save the pcx file
    WritePCXfile (lbmname, linear,
                  SCREENWIDTH, SCREENHEIGHT,
                  W_CacheLumpName ("PLAYPAL",PU_CACHE));

    players[consoleplayer].message = "screen shot";
}
```

## src/v_video.c
```c
// Emacs style mode select   -*- C++ -*-
//-----------------------------------------------------------------------------
//
// $Id:$
//
// Copyright (C) 1993-1996 by id Software, Inc.
//
// This program is free software; you can redistribute it and/or
// modify it under the terms of the GNU General Public License
// as published by the Free Software Foundation; either version 2
// of the License, or (at your option) any later version.
//
// This program is distributed in the hope that it will be useful,
// but WITHOUT ANY WARRANTY; without even the implied warranty of
// MERCHANTABILITY or FITNESS FOR A PARTICULAR PURPOSE.  See the
// GNU General Public License for more details.
//
// $Log:$
//
// DESCRIPTION:
//      Gamma correction LUT stuff.
//      Functions to draw patches (by post) directly to screen.
//      Functions to blit a block to the screen.
//
//-----------------------------------------------------------------------------

static const char __attribute__((unused))
rcsid[] = "$Id: v_video.c,v 1.5 1997/02/03 22:45:13 b1 Exp $";


#include "i_system.h"
#include "r_local.h"

#include "doomdef.h"
#include "doomdata.h"

#include "m_bbox.h"
#include "m_swap.h"

#include "v_video.h"


// Each screen is [SCREENWIDTH*SCREENHEIGHT];
byte*                           screens[5];

int                             dirtybox[4];



// Now where did these came from?
byte gammatable[5][256] =
{
    {1,2,3,4,5,6,7,8,9,10,11,12,13,14,15,16,
     17,18,19,20,21,22,23,24,25,26,27,28,29,30,31,32,
     33,34,35,36,37,38,39,40,41,42,43,44,45,46,47,48,
     49,50,51,52,53,54,55,56,57,58,59,60,61,62,63,64,
     65,66,67,68,69,70,71,72,73,74,75,76,77,78,79,80,
     81,82,83,84,85,86,87,88,89,90,91,92,93,94,95,96,
     97,98,99,100,101,102,103,104,105,106,107,108,109,110,111,112,
     113,114,115,116,117,118,119,120,121,122,123,124,125,126,127,128,
     128,129,130,131,132,133,134,135,136,137,138,139,140,141,142,143,
     144,145,146,147,148,149,150,151,152,153,154,155,156,157,158,159,
     160,161,162,163,164,165,166,167,168,169,170,171,172,173,174,175,
     176,177,178,179,180,181,182,183,184,185,186,187,188,189,190,191,
     192,193,194,195,196,197,198,199,200,201,202,203,204,205,206,207,
     208,209,210,211,212,213,214,215,216,217,218,219,220,221,222,223,
     224,225,226,227,228,229,230,231,232,233,234,235,236,237,238,239,
     240,241,242,243,244,245,246,247,248,249,250,251,252,253,254,255},

    {2,4,5,7,8,10,11,12,14,15,16,18,19,20,21,23,24,25,26,27,29,30,31,
     32,33,34,36,37,38,39,40,41,42,44,45,46,47,48,49,50,51,52,54,55,
     56,57,58,59,60,61,62,63,64,65,66,67,69,70,71,72,73,74,75,76,77,
     78,79,80,81,82,83,84,85,86,87,88,89,90,91,92,93,94,95,96,97,98,
     99,100,101,102,103,104,105,106,107,108,109,110,111,112,113,114,
     115,116,117,118,119,120,121,122,123,124,125,126,127,128,129,129,
     130,131,132,133,134,135,136,137,138,139,140,141,142,143,144,145,
     146,147,148,148,149,150,151,152,153,154,155,156,157,158,159,160,
     161,162,163,163,164,165,166,167,168,169,170,171,172,173,174,175,
     175,176,177,178,179,180,181,182,183,184,185,186,186,187,188,189,
     190,191,192,193,194,195,196,196,197,198,199,200,201,202,203,204,
     205,205,206,207,208,209,210,211,212,213,214,214,215,216,217,218,
     219,220,221,222,222,223,224,225,226,227,228,229,230,230,231,232,
     233,234,235,236,237,237,238,239,240,241,242,243,244,245,245,246,
     247,248,249,250,251,252,252,253,254,255},

    {4,7,9,11,13,15,17,19,21,22,24,26,27,29,30,32,33,35,36,38,39,40,42,
     43,45,46,47,48,50,51,52,54,55,56,57,59,60,61,62,63,65,66,67,68,69,
     70,72,73,74,75,76,77,78,79,80,82,83,84,85,86,87,88,89,90,91,92,93,
     94,95,96,97,98,100,101,102,103,104,105,106,107,108,109,110,111,112,
     113,114,114,115,116,117,118,119,120,121,122,123,124,125,126,127,128,
     129,130,131,132,133,133,134,135,136,137,138,139,140,141,142,143,144,
     144,145,146,147,148,149,150,151,152,153,153,154,155,156,157,158,159,
     160,160,161,162,163,164,165,166,166,167,168,169,170,171,172,172,173,
     174,175,176,177,178,178,179,180,181,182,183,183,184,185,186,187,188,
     188,189,190,191,192,193,193,194,195,196,197,197,198,199,200,201,201,
     202,203,204,205,206,206,207,208,209,210,210,211,212,213,213,214,215,
     216,217,217,218,219,220,221,221,222,223,224,224,225,226,227,228,228,
     229,230,231,231,232,233,234,235,235,236,237,238,238,239,240,241,241,
     242,243,244,244,245,246,247,247,248,249,250,251,251,252,253,254,254,
     255},

    {8,12,16,19,22,24,27,29,31,34,36,38,40,41,43,45,47,49,50,52,53,55,
     57,58,60,61,63,64,65,67,68,70,71,72,74,75,76,77,79,80,81,82,84,85,
     86,87,88,90,91,92,93,94,95,96,98,99,100,101,102,103,104,105,106,107,
     108,109,110,111,112,113,114,115,116,117,118,119,120,121,122,123,124,
     125,126,127,128,129,130,131,132,133,134,135,135,136,137,138,139,140,
     141,142,143,143,144,145,146,147,148,149,150,150,151,152,153,154,155,
     155,156,157,158,159,160,160,161,162,163,164,165,165,166,167,168,169,
     169,170,171,172,173,173,174,175,176,176,177,178,179,180,180,181,182,
     183,183,184,185,186,186,187,188,189,189,190,191,192,192,193,194,195,
     195,196,197,197,198,199,200,200,201,202,202,203,204,205,205,206,207,
     207,208,209,210,210,211,212,212,213,214,214,215,216,216,217,218,219,
     219,220,221,221,222,223,223,224,225,225,226,227,227,228,229,229,230,
     231,231,232,233,233,234,235,235,236,237,237,238,238,239,240,240,241,
     242,242,243,244,244,245,246,246,247,247,248,249,249,250,251,251,252,
     253,253,254,254,255},

    {16,23,28,32,36,39,42,45,48,50,53,55,57,60,62,64,66,68,69,71,73,75,76,
     78,80,81,83,84,86,87,89,90,92,93,94,96,97,98,100,101,102,103,105,106,
     107,108,109,110,112,113,114,115,116,117,118,119,120,121,122,123,124,
     125,126,128,128,129,130,131,132,133,134,135,136,137,138,139,140,141,
     142,143,143,144,145,146,147,148,149,150,150,151,152,153,154,155,155,
     156,157,158,159,159,160,161,162,163,163,164,165,166,166,167,168,169,
     169,170,171,172,172,173,174,175,175,176,177,177,178,179,180,180,181,
     182,182,183,184,184,185,186,187,187,188,189,189,190,191,191,192,193,
     193,194,195,195,196,196,197,198,198,199,200,200,201,202,202,203,203,
     204,205,205,206,207,207,208,208,209,210,210,211,211,212,213,213,214,
     214,215,216,216,217,217,218,219,219,220,220,221,221,222,223,223,224,
     224,225,225,226,227,227,228,228,229,229,230,230,231,232,232,233,233,
     234,234,235,235,236,236,237,237,238,239,239,240,240,241,241,242,242,
     243,243,244,244,245,245,246,246,247,247,248,248,249,249,250,250,251,
     251,252,252,253,254,254,255,255}
};



int     usegamma;

//
// V_MarkRect
//
void
V_MarkRect
( int           x,
  int           y,
  int           width,
  int           height )
{
    M_AddToBox (dirtybox, x, y);
    M_AddToBox (dirtybox, x+width-1, y+height-1);
}


//
// V_CopyRect
//
void
V_CopyRect
( int           srcx,
  int           srcy,
  int           srcscrn,
  int           width,
  int           height,
  int           destx,
  int           desty,
  int           destscrn )
{
    byte*       src;
    byte*       dest;

#ifdef RANGECHECK
    if (srcx<0
        ||srcx+width >SCREENWIDTH
        || srcy<0
        || srcy+height>SCREENHEIGHT
        ||destx<0||destx+width >SCREENWIDTH
        || desty<0
        || desty+height>SCREENHEIGHT
        || (unsigned)srcscrn>4
        || (unsigned)destscrn>4)
    {
        I_Error ("Bad V_CopyRect");
    }
#endif
    V_MarkRect (destx, desty, width, height);

    src = screens[srcscrn]+SCREENWIDTH*srcy+srcx;
    dest = screens[destscrn]+SCREENWIDTH*desty+destx;

    for ( ; height>0 ; height--)
    {
        memcpy (dest, src, width);
        src += SCREENWIDTH;
        dest += SCREENWIDTH;
    }
}


//
// V_DrawPatch
// Masks a column based masked pic to the screen.
//
void
V_DrawPatch
( int           x,
  int           y,
  int           scrn,
  patch_t*      patch )
{

    int         count;
    int         col;
    column_t*   column;
    byte*       desttop;
    byte*       dest;
    byte*       source;
    int         w;

    y -= SHORT(patch->topoffset);
    x -= SHORT(patch->leftoffset);
#ifdef RANGECHECK
    if (x<0
        ||x+SHORT(patch->width) >SCREENWIDTH
        || y<0
        || y+SHORT(patch->height)>SCREENHEIGHT
        || (unsigned)scrn>4)
    {
      fprintf( stderr, "Patch at %d,%d exceeds LFB\n", x,y );
      // No I_Error abort - what is up with TNT.WAD?
      fprintf( stderr, "V_DrawPatch: bad patch (ignored)\n");
      return;
    }
#endif

    if (!scrn)
        V_MarkRect (x, y, SHORT(patch->width), SHORT(patch->height));

    col = 0;
    desttop = screens[scrn]+y*SCREENWIDTH+x;

    w = SHORT(patch->width);

    for ( ; col<w ; x++, col++, desttop++)
    {
        column = (column_t *)((byte *)patch + LONG(patch->columnofs[col]));

        // step through the posts in a column
        while (column->topdelta != 0xff )
        {
            source = (byte *)column + 3;
            dest = desttop + column->topdelta*SCREENWIDTH;
            count = column->length;

            while (count--)
            {
                *dest = *source++;
                dest += SCREENWIDTH;
            }
            column = (column_t *)(  (byte *)column + column->length
                                    + 4 );
        }
    }
}

//
// V_DrawPatchFlipped
// Masks a column based masked pic to the screen.
// Flips horizontally, e.g. to mirror face.
//
void
V_DrawPatchFlipped
( int           x,
  int           y,
  int           scrn,
  patch_t*      patch )
{

    int         count;
    int         col;
    column_t*   column;
    byte*       desttop;
    byte*       dest;
    byte*       source;
    int         w;

    y -= SHORT(patch->topoffset);
    x -= SHORT(patch->leftoffset);
#ifdef RANGECHECK
    if (x<0
        ||x+SHORT(patch->width) >SCREENWIDTH
        || y<0
        || y+SHORT(patch->height)>SCREENHEIGHT
        || (unsigned)scrn>4)
    {
      fprintf( stderr, "Patch origin %d,%d exceeds LFB\n", x,y );
      I_Error ("Bad V_DrawPatch in V_DrawPatchFlipped");
    }
#endif

    if (!scrn)
        V_MarkRect (x, y, SHORT(patch->width), SHORT(patch->height));

    col = 0;
    desttop = screens[scrn]+y*SCREENWIDTH+x;

    w = SHORT(patch->width);

    for ( ; col<w ; x++, col++, desttop++)
    {
        column = (column_t *)((byte *)patch + LONG(patch->columnofs[w-1-col]));

        // step through the posts in a column
        while (column->topdelta != 0xff )
        {
            source = (byte *)column + 3;
            dest = desttop + column->topdelta*SCREENWIDTH;
            count = column->length;

            while (count--)
            {
                *dest = *source++;
                dest += SCREENWIDTH;
            }
            column = (column_t *)(  (byte *)column + column->length
                                    + 4 );
        }
    }
}



//
// V_DrawPatchDirect
// Draws directly to the screen on the pc.
//
void
V_DrawPatchDirect
( int           x,
  int           y,
  int           scrn,
  patch_t*      patch )
{
    V_DrawPatch (x,y,scrn, patch);

    /*
    int         count;
    int         col;
    column_t*   column;
    byte*       desttop;
    byte*       dest;
    byte*       source;
    int         w;

    y -= SHORT(patch->topoffset);
    x -= SHORT(patch->leftoffset);

#ifdef RANGECHECK
    if (x<0
        ||x+SHORT(patch->width) >SCREENWIDTH
        || y<0
        || y+SHORT(patch->height)>SCREENHEIGHT
        || (unsigned)scrn>4)
    {
        I_Error ("Bad V_DrawPatchDirect");
    }
#endif

    //  V_MarkRect (x, y, SHORT(patch->width), SHORT(patch->height));
    desttop = destscreen + y*SCREENWIDTH/4 + (x>>2);

    w = SHORT(patch->width);
    for ( col = 0 ; col<w ; col++)
    {
        outp (SC_INDEX+1,1<<(x&3));
        column = (column_t *)((byte *)patch + LONG(patch->columnofs[col]));

        // step through the posts in a column

        while (column->topdelta != 0xff )
        {
            source = (byte *)column + 3;
            dest = desttop + column->topdelta*SCREENWIDTH/4;
            count = column->length;

            while (count--)
            {
                *dest = *source++;
                dest += SCREENWIDTH/4;
            }
            column = (column_t *)(  (byte *)column + column->length
                                    + 4 );
        }
        if ( ((++x)&3) == 0 )
            desttop++;  // go to next byte, not next plane
    }*/
}



//
// V_DrawBlock
// Draw a linear block of pixels into the view buffer.
//
void
V_DrawBlock
( int           x,
  int           y,
  int           scrn,
  int           width,
  int           height,
  byte*         src )
{
    byte*       dest;

#ifdef RANGECHECK
    if (x<0
        ||x+width >SCREENWIDTH
        || y<0
        || y+height>SCREENHEIGHT
        || (unsigned)scrn>4 )
    {
        I_Error ("Bad V_DrawBlock");
    }
#endif

    V_MarkRect (x, y, width, height);

    dest = screens[scrn] + y*SCREENWIDTH+x;

    while (height--)
    {
        memcpy (dest, src, width);
        src += width;
        dest += SCREENWIDTH;
    }
}



//
// V_GetBlock
// Gets a linear block of pixels from the view buffer.
//
void
V_GetBlock
( int           x,
  int           y,
  int           scrn,
  int           width,
  int           height,
  byte*         dest )
{
    byte*       src;

#ifdef RANGECHECK
    if (x<0
        ||x+width >SCREENWIDTH
        || y<0
        || y+height>SCREENHEIGHT
        || (unsigned)scrn>4 )
    {
        I_Error ("Bad V_DrawBlock");
    }
#endif

    src = screens[scrn] + y*SCREENWIDTH+x;

    while (height--)
    {
        memcpy (dest, src, width);
        src += SCREENWIDTH;
        dest += width;
    }
}




//
// V_Init
//
void V_Init (void)
{
    int         i;
    byte*       base;

    // stick these in low dos memory on PCs
    printf("%s: allocating mem for screens: %d\n", __FUNCTION__, SCREENWIDTH*SCREENHEIGHT*4);
    base = I_AllocLow (SCREENWIDTH*SCREENHEIGHT*4);

    for (i=0 ; i<4 ; i++)
        screens[i] = base + i*SCREENWIDTH*SCREENHEIGHT;
}
```

## src/w_wad.c
```c
// Emacs style mode select   -*- C++ -*-
//-----------------------------------------------------------------------------
//
// $Id:$
//
// Copyright (C) 1993-1996 by id Software, Inc.
//
// This program is free software; you can redistribute it and/or
// modify it under the terms of the GNU General Public License
// as published by the Free Software Foundation; either version 2
// of the License, or (at your option) any later version.
//
// This program is distributed in the hope that it will be useful,
// but WITHOUT ANY WARRANTY; without even the implied warranty of
// MERCHANTABILITY or FITNESS FOR A PARTICULAR PURPOSE.  See the
// GNU General Public License for more details.
//
// $Log:$
//
// DESCRIPTION:
//      Handles WAD file header, directory, lump I/O.
//
//-----------------------------------------------------------------------------

static const char __attribute__((unused))
rcsid[] = "$Id: w_wad.c,v 1.5 1997/02/03 16:47:57 b1 Exp $";


#ifdef NORMALUNIX
#include <ctype.h>
#include <sys/types.h>
#include <string.h>
#include <unistd.h>
#include <malloc.h>
#include <fcntl.h>
#include <sys/stat.h>
#include <alloca.h>
#define O_BINARY                0
#endif

#include "doomtype.h"
#include "m_swap.h"
#include "i_system.h"
#include "z_zone.h"

#ifdef __GNUG__
#pragma implementation "w_wad.h"
#endif
#include "w_wad.h"






//
// GLOBALS
//

// Location of each lump on disk.
lumpinfo_t*             lumpinfo;
int                     numlumps;

void**                  lumpcache;


#define strcmpi strcasecmp

char* strupr (char* str)
{
    char *s = str;
    while (*s) { *s = toupper(*s); s++; }
    return str;
}

int filelength (int handle)
{
    struct stat fileinfo;

    if (fstat (handle,&fileinfo) == -1)
        I_Error ("Error fstating");

    return fileinfo.st_size;
}


void
ExtractFileBase
( char*         path,
  char*         dest )
{
    char*       src;
    int         length;

    src = path + strlen(path) - 1;

    // back up until a \ or the start
    while (src != path
           && *(src-1) != '\\'
           && *(src-1) != '/')
    {
        src--;
    }

    // copy up to eight characters
    memset (dest,0,8);
    length = 0;

    while (*src && *src != '.')
    {
        if (++length == 9)
            I_Error ("Filename base of %s >8 chars",path);

        *dest++ = toupper((int)*src++);
    }
}





//
// LUMP BASED ROUTINES.
//

//
// W_AddFile
// All files are optional, but at least one file must be
//  found (PWAD, if all required lumps are present).
// Files with a .wad extension are wadlink files
//  with multiple lumps.
// Other files are single lumps with the base filename
//  for the lump name.
//
// If filename starts with a tilde, the file is handled
//  specially to allow map reloads.
// But: the reload feature is a fragile hack...

int                     reloadlump;
char*                   reloadname;


void W_AddFile (char *filename)
{
    wadinfo_t           header;
    lumpinfo_t*         lump_p;
    unsigned            i;
    int                 handle;
    int                 length;
    int                 startlump;
    filelump_t*         fileinfo;
    filelump_t          singleinfo;
    int                 storehandle;

    // open the file and add to directory

    // handle reload indicator.
    if (filename[0] == '~')
    {
        filename++;
        reloadname = filename;
        reloadlump = numlumps;
    }

    if ( (handle = open (filename, O_RDONLY | O_BINARY)) == -1)
    {
        printf (" couldn't open %s\n",filename);
        return;
    }

    printf (" adding %s\n",filename);
    startlump = numlumps;

    if (strcmpi (filename+strlen(filename)-3 , "wad" ) )
    {
        // single lump file
        fileinfo = &singleinfo;
        singleinfo.filepos = 0;
        singleinfo.size = LONG(filelength(handle));
        ExtractFileBase (filename, singleinfo.name);
        numlumps++;
    }
    else
    {
        // WAD file
        read (handle, &header, sizeof(header));
        if (strncmp(header.identification,"IWAD",4))
        {
            // Homebrew levels?
            if (strncmp(header.identification,"PWAD",4))
            {
                I_Error ("Wad file %s doesn't have IWAD "
                         "or PWAD id\n", filename);
            }

            // ???modifiedgame = true;
        }
        header.numlumps = LONG(header.numlumps);
        header.infotableofs = LONG(header.infotableofs);
        length = header.numlumps*sizeof(filelump_t);
        fileinfo = alloca (length);
        lseek (handle, header.infotableofs, SEEK_SET);
        if (read (handle, fileinfo, length) < 0)
            perror("read\n");
        numlumps += header.numlumps;
    }

#if 0
    printf("numlumps = %d\n", numlumps);
    hexdump(fileinfo, length);
#endif
    // Fill in lumpinfo
    lumpinfo = realloc (lumpinfo, numlumps*sizeof(lumpinfo_t));

    if (!lumpinfo)
        I_Error ("Couldn't realloc lumpinfo");

    lump_p = &lumpinfo[startlump];

    storehandle = reloadname ? -1 : handle;

    for (i=startlump ; i<numlumps ; i++,lump_p++, fileinfo++)
    {
        lump_p->handle = storehandle;
        lump_p->position = LONG(fileinfo->filepos);
        lump_p->size = LONG(fileinfo->size);
        strncpy (lump_p->name, fileinfo->name, 8);
    }
    
    if (reloadname)
        close (handle);

}




//
// W_Reload
// Flushes any of the reloadable lumps in memory
//  and reloads the directory.
//
void W_Reload (void)
{
    wadinfo_t           header;
    int                 lumpcount;
    lumpinfo_t*         lump_p;
    unsigned            i;
    int                 handle;
    int                 length;
    filelump_t*         fileinfo;

    if (!reloadname)
        return;

    if ( (handle = open (reloadname,O_RDONLY | O_BINARY)) == -1)
        I_Error ("W_Reload: couldn't open %s",reloadname);

    read (handle, &header, sizeof(header));
    lumpcount = LONG(header.numlumps);
    header.infotableofs = LONG(header.infotableofs);
    length = lumpcount*sizeof(filelump_t);
    fileinfo = alloca (length);
    lseek (handle, header.infotableofs, SEEK_SET);
    read (handle, fileinfo, length);

    // Fill in lumpinfo
    lump_p = &lumpinfo[reloadlump];

    for (i=reloadlump ;
         i<reloadlump+lumpcount ;
         i++,lump_p++, fileinfo++)
    {
        if (lumpcache[i])
            Z_Free (lumpcache[i]);

        lump_p->position = LONG(fileinfo->filepos);
        lump_p->size = LONG(fileinfo->size);
    }

    close (handle);
}



//
// W_InitMultipleFiles
// Pass a null terminated list of files to use.
// All files are optional, but at least one file
//  must be found.
// Files with a .wad extension are idlink files
//  with multiple lumps.
// Other files are single lumps with the base filename
//  for the lump name.
// Lump names can appear multiple times.
// The name searcher looks backwards, so a later file
//  does override all earlier ones.
//
void W_InitMultipleFiles (char** filenames)
{
    int         size;

    // open all the files, load headers, and count lumps
    numlumps = 0;

    // will be realloced as lumps are added
    lumpinfo = malloc(1);

    for ( ; *filenames ; filenames++)
        W_AddFile (*filenames);

    if (!numlumps)
        I_Error ("W_InitFiles: no files found");

    // set up caching
    size = numlumps * sizeof(*lumpcache);
    lumpcache = malloc (size);

    if (!lumpcache)
        I_Error ("Couldn't allocate lumpcache");

    memset (lumpcache,0, size);
}




//
// W_InitFile
// Just initialize from a single file.
//
void W_InitFile (char* filename)
{
    char*       names[2];

    names[0] = filename;
    names[1] = NULL;
    W_InitMultipleFiles (names);
}



//
// W_NumLumps
//
int W_NumLumps (void)
{
    return numlumps;
}



//
// W_CheckNumForName
// Returns -1 if name not found.
//

int W_CheckNumForName (char* name)
{
    union {
        char    s[9];
        int     x[2];

    } name8;

    int         v1;
    int         v2;
    lumpinfo_t* lump_p;

    // make the name into two integers for easy compares
    strncpy (name8.s,name,8);

    // in case the name was a fill 8 chars
    name8.s[8] = 0;

    // case insensitive
    strupr (name8.s);

    v1 = name8.x[0];
    v2 = name8.x[1];


    // scan backwards so patch lump files take precedence
    lump_p = lumpinfo + numlumps;

    while (lump_p-- != lumpinfo)
    {
        if ( *(int *)lump_p->name == v1
             && *(int *)&lump_p->name[4] == v2)
        {
            return lump_p - lumpinfo;
        }
    }

    // TFB. Not found.
    return -1;
}




//
// W_GetNumForName
// Calls W_CheckNumForName, but bombs out if not found.
//
int W_GetNumForName (char* name)
{
    int i;

    i = W_CheckNumForName (name);

    if (i == -1)
      I_Error ("W_GetNumForName: %s not found!", name);

    return i;
}


//
// W_LumpLength
// Returns the buffer size needed to load the given lump.
//
int W_LumpLength (int lump)
{
    if (lump >= numlumps)
        I_Error ("W_LumpLength: %i >= numlumps",lump);

    return lumpinfo[lump].size;
}



//
// W_ReadLump
// Loads the lump into the given buffer,
//  which must be >= W_LumpLength().
//
void
W_ReadLump
( int           lump,
  void*         dest )
{
    int         c;
    lumpinfo_t* l;
    int         handle;

    if (lump >= numlumps)
        I_Error ("W_ReadLump: %i >= numlumps",lump);

    l = lumpinfo+lump;

    // ??? I_BeginRead ();

    if (l->handle == -1)
    {
        // reloadable file, so use open / read / close
        if ( (handle = open (reloadname,O_RDONLY | O_BINARY)) == -1)
            I_Error ("W_ReadLump: couldn't open %s",reloadname);
    }
    else
        handle = l->handle;
    lseek (handle, l->position, SEEK_SET);
    c = read (handle, dest, l->size);

    if (c < l->size)
        I_Error ("W_ReadLump: only read %i of %i on lump %i",
                 c,l->size,lump);

    if (l->handle == -1)
        close (handle);

    // ??? I_EndRead ();
}




//
// W_CacheLumpNum
//
void*
W_CacheLumpNum
( int           lump,
  int           tag )
{
    if ((unsigned)lump >= numlumps)
        I_Error ("W_CacheLumpNum: %i >= numlumps",lump);

    if (!lumpcache[lump])
    {
        // read the lump in

        //printf ("cache miss on lump %i\n",lump);
        Z_Malloc (W_LumpLength (lump), tag, &lumpcache[lump]);
        W_ReadLump (lump, lumpcache[lump]);
    }
    else
    {
        //printf ("cache hit on lump %i\n",lump);
        Z_ChangeTag (lumpcache[lump],tag);
    }

    return lumpcache[lump];
}



//
// W_CacheLumpName
//
void*
W_CacheLumpName
( char*         name,
  int           tag )
{
    return W_CacheLumpNum (W_GetNumForName(name), tag);
}


//
// W_Profile
//
int             info[2500][10];
int             profilecount;

void W_Profile (void)
{
    int         i;
    memblock_t* block;
    void*       ptr;
    char        ch;
    FILE*       f;
    int         j;
    char        name[9];


    for (i=0 ; i<numlumps ; i++)
    {
        ptr = lumpcache[i];
        if (!ptr)
        {
            ch = ' ';
            continue;
        }
        else
        {
            block = (memblock_t *) ( (byte *)ptr - sizeof(memblock_t));
            if (block->tag < PU_PURGELEVEL)
                ch = 'S';
            else
                ch = 'P';
        }
        info[i][profilecount] = ch;
    }
    profilecount++;

    f = fopen ("waddump.txt","w");
    name[8] = 0;

    for (i=0 ; i<numlumps ; i++)
    {
        memcpy (name,lumpinfo[i].name,8);

        for (j=0 ; j<8 ; j++)
            if (!name[j])
                break;

        for ( ; j<8 ; j++)
            name[j] = ' ';

        fprintf (f,"%s ",name);

        for (j=0 ; j<profilecount ; j++)
            fprintf (f,"    %c",info[i][j]);

        fprintf (f,"\n");
    }
    fclose (f);
}
```
